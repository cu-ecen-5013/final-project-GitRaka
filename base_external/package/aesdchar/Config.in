## base_external/package/aesdchar/Config.in
```kconfig
config BR2_PACKAGE_AESDCHAR
        bool "aesdchar"
        help
          Includes for the aesdchar for assignment-8
```

## base_external/package/ldd/Config.in
```kconfig
config BR2_PACKAGE_LDD
        bool "ldd"
        help
          Includes for the ldd for assignment
```
